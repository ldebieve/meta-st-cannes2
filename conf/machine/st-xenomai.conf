## conf/machine/st-xenomai.conf
```bitbake
#@TYPE: Machine
#@NAME: st-xenomai
#@DESCRIPTION: Machine configuration for XENOMAI to build with Linux-STI Kernel 4.6 support
#@NEEDED_BSPLAYERS: meta-st/meta-st-cannes2

include conf/machine/stih410-b2260.conf

MACHINEOVERRIDES =. "st-xenomai:"

MACHINE_EXTRA_RDEPENDS += "xenomai"
```
